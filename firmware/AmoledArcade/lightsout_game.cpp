// lightsout_game.cpp - Lights Out: press a lamp and it flips itself and its four neighbours. Switch them all off.
//   CURSOR = TILT:    tilt moves the cursor one cell (hold the tilt to repeat), RIGHT = toggle, LEFT = hint
//   CURSOR = BUTTONS: LEFT (tap) = cursor to the next cell (wraps row by row), RIGHT = toggle, hold LEFT = hint
//   TAP a lamp = toggle it (both modes).   Home: triple-tap BOOT / touch-hold the top-left corner.
// SIZE: 4x4, 5x5 or 6x6. Boards are generated by pressing random lamps on a dark board, so they are always solvable
// and PAR (the number of generated presses) is an upper bound of the minimum. Stars: <= par 3, <= par+3 2, else 1,
// minus one per hint. Every level adds one press. Score = levels cleared (best saved per size).
#include "engine.h"
#include <math.h>

static const char *const LO_SIZES[] = {"4 x 4", "5 x 5", "6 x 6"};
static const char *const LO_CTRL[] = {"TILT", "BUTTONS"};
static Option loOpts[] = {{"SIZE", LO_SIZES, 3, "loSize", 1}, {"CURSOR", LO_CTRL, 2, "loCtl", 0}};

enum LoSt : uint8_t { LO_INTRO, LO_PLAY, LO_WIN };
static constexpr int LO_MAXC = 36;
static constexpr int LO_AREA = 300, LO_X0 = 74, LO_Y0 = 46;
static const uint16_t LO_ON = rgb(255, 176, 40), LO_OFF = rgb(26, 20, 38);

static uint8_t loB[LO_MAXC], loSol[LO_MAXC];
static float loLit[LO_MAXC];
static LoSt loSt;
static int loN, loCur, loLevel, loMoves, loPar, loHints, loCtl, loHintCell, loStars, loScore, loCleared;
static uint32_t loBest, loStAt, loLastT, loLastRender, loHintUntil, loRepeatAt, loLPressAt;
static bool loNewBest, loLHeldPrev, loLLong;
static uint8_t loPrevDir;
static SnapDir loSnap;

static void loKey(char *k) { snprintf(k, 16, "loBest%d", loN); }
static void loFlip(int c, uint8_t *b) {
  int x = c % loN, y = c / loN;
  b[c] ^= 1;
  if (x > 0) b[c - 1] ^= 1;
  if (x < loN - 1) b[c + 1] ^= 1;
  if (y > 0) b[c - loN] ^= 1;
  if (y < loN - 1) b[c + loN] ^= 1;
}
static bool loSolved() {
  for (int i = 0; i < loN * loN; i++) if (loB[i]) return false;
  return true;
}
static void loGen() {
  int cells = loN * loN;
  int k = 2 + loLevel;
  int cap = cells * 2 / 3;
  if (k > cap) k = cap;
  do {
    memset(loB, 0, sizeof loB); memset(loSol, 0, sizeof loSol);
    for (int i = 0; i < k; i++) {
      int c;
      do c = random(cells); while (loSol[c]);
      loSol[c] = 1; loFlip(c, loB);
    }
  } while (loSolved());
  loPar = k; loMoves = 0; loHints = 0; loHintCell = -1; loHintUntil = 0;
  for (int i = 0; i < cells; i++) loLit[i] = loB[i];
}
static void loStartLevel(uint32_t now) {
  loGen(); loSt = LO_PLAY; loStAt = now; loSnap = SnapDir(); loPrevDir = DIR_NONE;
  imuZero();
}
static void loStart() {
  loN = 4 + loOpts[0].value; loCtl = loOpts[1].value;
  char k[16]; loKey(k);
  loBest = loadBest(k);
  loLevel = 1; loCleared = 0; loCur = (loN * loN) / 2; loNewBest = false; loLHeldPrev = false; loLLong = false;
  loLastT = millis(); loLastRender = 0;
  loGen(); loSt = LO_INTRO; loStAt = loLastT;
  imuZero();
  sfxStart();
}

static void loHint(uint32_t now) {
  int best = -1, bd = 1 << 20, cx = loCur % loN, cy = loCur / loN;
  for (int i = 0; i < loN * loN; i++) {
    if (!loSol[i]) continue;
    int d = abs(i % loN - cx) + abs(i / loN - cy);
    if (d < bd) { bd = d; best = i; }
  }
  if (best < 0) return;
  loHintCell = best; loHintUntil = now + 2500; loHints++;
  play(880, 40); play(1175, 60);
}
static void loToggle(int c, uint32_t now) {
  loFlip(c, loB); loSol[c] ^= 1; loMoves++;
  if (c == loHintCell) loHintCell = -1;
  play(420 + (loB[c] ? 120 : 0), 14);
  if (loSolved()) {
    loCleared = loLevel;
    int s = loMoves <= loPar ? 3 : loMoves <= loPar + 3 ? 2 : 1;
    loStars = s - loHints; if (loStars < 0) loStars = 0;
    char k[16]; loKey(k);
    loNewBest = saveBest(k, loCleared);
    if (loNewBest) loBest = loCleared;
    tunePlay(TUNE_WIN);
    loSt = LO_WIN; loStAt = now;
  }
}

static void loStarShape(int cx, int cy, int r, uint16_t c) {
  gfx->fillTriangle(cx, cy - r, cx - r * 7 / 8, cy + r / 2, cx + r * 7 / 8, cy + r / 2, c);
  gfx->fillTriangle(cx, cy + r, cx - r * 7 / 8, cy - r / 2, cx + r * 7 / 8, cy - r / 2, c);
}

static void loRender(uint32_t now) {
  gfx->fillScreen(C_BG);
  int cs = LO_AREA / loN, cells = loN * loN;
  // halos first (they spill into the gaps), lamps on top
  for (int i = 0; i < cells; i++) {
    float g = loLit[i];
    if (g < 0.1f) continue;
    int x = LO_X0 + (i % loN) * cs + 2, y = LO_Y0 + (i / loN) * cs + 2, w = cs - 4;
    for (int k = 3; k >= 1; k--)
      gfx->drawRoundRect(x - k, y - k, w + 2 * k, w + 2 * k, 8 + k, lerpColor(LO_ON, C_BG, 1.0f - g * 0.32f / k));
  }
  for (int i = 0; i < cells; i++) {
    float g = loLit[i];
    int x = LO_X0 + (i % loN) * cs + 2, y = LO_Y0 + (i / loN) * cs + 2, w = cs - 4;
    gfx->fillRoundRect(x, y, w, w, 8, lerpColor(LO_OFF, LO_ON, g));
    if (g > 0.05f) {
      int in2 = w / 5;
      gfx->fillRoundRect(x + in2, y + in2, w - 2 * in2, w - 2 * in2, 5, lerpColor(lerpColor(LO_OFF, LO_ON, g), rgb(255, 240, 190), g * 0.8f));
    } else {
      gfx->drawRoundRect(x, y, w, w, 8, rgb(52, 44, 74));
    }
  }
  if (loHintCell >= 0 && now < loHintUntil) {
    int x = LO_X0 + (loHintCell % loN) * cs + cs / 2, y = LO_Y0 + (loHintCell / loN) * cs + cs / 2;
    int r = 5 + (int)(3.0f * (0.5f + 0.5f * sinf(now * 0.012f)));
    gfx->fillCircle(x, y, r, C_CYAN);
    gfx->drawCircle(x, y, r + 3, lerpColor(C_CYAN, C_BG, 0.5f));
  }
  if (loSt == LO_PLAY) {
    int x = LO_X0 + (loCur % loN) * cs, y = LO_Y0 + (loCur / loN) * cs;
    float p = 0.5f + 0.5f * sinf(now * 0.008f);
    uint16_t cc = lerpColor(C_CYAN, C_TEXT, p);
    gfx->drawRoundRect(x, y, cs, cs, 10, cc);
    gfx->drawRoundRect(x + 1, y + 1, cs - 2, cs - 2, 9, cc);
  }
  hudBar(loCleared, loBest, rgb(8, 8, 22), C_TEXT);
  char b[16];
  text("MOVES", 6, 100, 1, C_DIM);
  snprintf(b, sizeof b, "%d", loMoves);
  text(b, 6, 114, 3, C_TEXT);
  text("PAR", W - 66, 100, 1, C_DIM);
  snprintf(b, sizeof b, "%d", loPar);
  text(b, W - 66, 114, 3, C_ACC);
  text("LEVEL", W - 66, 160, 1, C_DIM);
  snprintf(b, sizeof b, "%d", loLevel);
  text(b, W - 66, 174, 3, C_CYAN);
  centerText(loCtl ? "LEFT next  RIGHT toggle  hold LEFT hint" : "TILT move   RIGHT toggle   LEFT hint", 354, 1, C_DIM);

  if (loSt == LO_INTRO) {
    gfx->fillRoundRect(46, 112, W - 92, 132, 16, C_PANEL);
    gfx->drawRoundRect(46, 112, W - 92, 132, 16, C_ACC);
    centerText("LIGHTS OUT", 124, 3, C_ACC);
    centerText("a press flips a lamp and its 4 neighbours", 164, 1, C_TEXT);
    centerText("turn every lamp off", 180, 1, C_TEXT);
    centerText(loCtl ? "LEFT = next cell   RIGHT = toggle" : "TILT = cursor   RIGHT = toggle", 200, 1, C_DIM);
    centerText("tap a lamp also works", 214, 1, C_DIM);
  } else if (loSt == LO_WIN) {
    gfx->fillRoundRect(80, 120, W - 160, 118, 16, C_PANEL);
    gfx->drawRoundRect(80, 120, W - 160, 118, 16, C_GOOD);
    centerText(loNewBest ? "SOLVED - NEW BEST" : "SOLVED", 130, 2, C_GOOD);
    for (int s = 0; s < 3; s++) loStarShape(W / 2 - 50 + s * 50, 176, 16, s < loStars ? C_ACC : rgb(48, 44, 30));
    snprintf(b, sizeof b, "%d moves (par %d)", loMoves, loPar);
    centerText(b, 206, 1, C_TEXT);
    if (now - loStAt > 900) centerText("press for the next level", 222, 1, C_DIM);
  }
  dirty = true;
}

static bool loFrame(uint32_t now) {
  homeLock = true;                                         // quick BOOT presses are the game
  float dt = fminf((now - loLastT) / 1000.0f, 0.05f);
  loLastT = now;
  tuneUpdate(now);
  for (int i = 0; i < loN * loN; i++) {                    // lamp glow eases toward the state
    float t = loB[i], d = t - loLit[i], s = dt * 14.0f;
    loLit[i] += fabsf(d) < s ? d : (d > 0 ? s : -s);
  }
  bool any = in.left || in.right || in.tap;
  if (loSt == LO_INTRO) {
    if (now - loStAt > 4000 || (any && now - loStAt > 250)) loStartLevel(now);
  } else if (loSt == LO_WIN) {
    if (now - loStAt > 900 && any) { loLevel++; loStartLevel(now); }
  } else {
    int cells = loN * loN;
    if (loCtl == 0) {
      // STICK: axisX()/axisY() return the analog stick (when deflected) instead of the tilt, so it works unchanged.
      uint8_t d = loSnap.update(axisX(), axisY(), 0.26f, 0.14f);
      bool go = false;
      if (d != DIR_NONE) {
        if (d != loPrevDir) { go = true; loRepeatAt = now + 420; }
        else if (now >= loRepeatAt) { go = true; loRepeatAt = now + 200; }
      }
      loPrevDir = d;
      if (go) {
        int x = loCur % loN, y = loCur / loN;
        if (d == DIR_L && x > 0) x--;
        else if (d == DIR_R && x < loN - 1) x++;
        else if (d == DIR_U && y > 0) y--;
        else if (d == DIR_D && y < loN - 1) y++;
        int n = y * loN + x;
        if (n != loCur) { loCur = n; play(900, 8); }
      }
      if (in.right) loToggle(loCur, now);
      if (in.left) loHint(now);
    } else {
      if (in.right) loToggle(loCur, now);
      if (in.left) { loLPressAt = now; loLLong = false; }
      if (in.leftDown && !loLLong && now - loLPressAt >= 650) { loLLong = true; loHint(now); }
      if (loLHeldPrev && !in.leftDown && !loLLong) { loCur = (loCur + 1) % cells; play(900, 8); }
      loLHeldPrev = in.leftDown;
    }
    if (in.tap && loSt == LO_PLAY) {
      int cs = LO_AREA / loN;
      int cx = (in.tapX - LO_X0) / cs, cy = (in.tapY - LO_Y0) / cs;
      if (in.tapX >= LO_X0 && in.tapY >= LO_Y0 && cx < loN && cy < loN) { loCur = cy * loN + cx; loToggle(loCur, now); }
    }
  }
  if (now - loLastRender >= 16) { loLastRender = now; loRender(now); }
  return true;
}

Game GAME_LIGHTSOUT = {"LIGHTS OUT", "flip lamps, switch them all off", 0xFD20, loOpts, 2, loStart, loFrame};
